## sdk_use/bsp/os/Huawei_LiteOS/compat/cmsis/Kconfig
```kconfig
config  LOSCFG_COMPAT_CMSIS
    bool "Enable Cmsis"
    default y
    depends on LOSCFG_PRODUCT_IPCAMERA || LOSCFG_PRODUCT_TV
    help
      Answer Y to enable LiteOS support cmsis interface.
```

## sdk_use/bsp/os/Huawei_LiteOS/compat/linux/Kconfig
```kconfig
config  LOSCFG_COMPAT_LINUX
    bool "Enable Linux"
    default y
    depends on LOSCFG_PRODUCT_IPCAMERA || LOSCFG_PRODUCT_TV
    help
      Answer Y to enable LiteOS support linux interface.
```

## sdk_use/bsp/os/Huawei_LiteOS/compat/posix/Kconfig
```kconfig
config  LOSCFG_COMPAT_POSIX
    bool "Enable Posix"
    default y
    depends on LOSCFG_PRODUCT_IPCAMERA || LOSCFG_PRODUCT_TV
    help
      Answer Y to enable LiteOS support posix interface.
```
